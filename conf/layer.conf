## conf/layer.conf
```bitbake
# We have a conf and classes directory, add to BBPATH
BBPATH .= ":${LAYERDIR}"

# We have recipes-* directories, add to BBFILES
BBFILES += "${LAYERDIR}/recipes-*/*/*.bb \
	${LAYERDIR}/recipes-*/*/*.bbappend"

BBFILE_COLLECTIONS += "meta-fhe"
BBFILE_PATTERN_meta-fhe = "^${LAYERDIR}/"
BBFILE_PRIORITY_meta-fhe = "8"

LAYERSERIES_COMPAT_meta-fhe = "thud"
```
